#include "cygnus.dtsi"

/ {
    kscan0: kscan {
        col-gpios =
            <&gpio1 15 GPIO_ACTIVE_HIGH>,  /* col 0 */
            <&gpio1 13 GPIO_ACTIVE_HIGH>,  /* col 1 */
            <&gpio1 11 GPIO_ACTIVE_HIGH>,  /* col 2 */
            <&gpio0 10 GPIO_ACTIVE_HIGH>,  /* col 3 */
            <&gpio0 9  GPIO_ACTIVE_HIGH>;   /* col 4 */
    };
};
