#include "cygnus.dtsi"

&default_transform {
    col-offset = <5>;
};

&kscan0 {
    col-gpios =
        <&gpio0 31 GPIO_ACTIVE_HIGH>,
        <&gpio0 20 GPIO_ACTIVE_HIGH>,
        <&gpio1 11 GPIO_ACTIVE_HIGH>,
        <&gpio0 10 GPIO_ACTIVE_HIGH>,
        <&gpio0 9  GPIO_ACTIVE_HIGH>;
        wakeup-source;
};
